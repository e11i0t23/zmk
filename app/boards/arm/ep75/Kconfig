## app/boards/arm/ep75/Kconfig
```kconfig
# Copyright (c) 2021 Elliot Powell
# SPDX-License-Identifier: MIT

config BOARD_ENABLE_DCDC
	bool "Enable DCDC mode"
	select SOC_DCDC_NRF52X
	default y
	depends on BOARD_EP75_REV1
```

## app/boards/arm/ep75/Kconfig.board
```kconfig
# Copyright (c) 2020 The ZMK Contributors
# SPDX-License-Identifier: MIT

config BOARD_EP75_REV1
	bool "EP75_REV1"
	depends on SOC_NRF52840_QIAA
```

## app/boards/arm/ep75/Kconfig.defconfig
```kconfig
# EP75 keyboard configuration

# Copyright (c) 2021 Elliot Powell
# SPDX-License-Identifier: MIT

if BOARD_EP75_REV1

config ZMK_KEYBOARD_NAME
	default "EP75 rev1"

if USB

config USB_NRFX
	default y

config USB_DEVICE_STACK
	default y

endif # USB

config BT_CTLR
	default BT

config ZMK_BLE
	default y

config ZMK_USB
	default y

config ZMK_BATTERY_VOLTAGE_DIVIDER
	default y

endif # BOARD_EP75_REV1
```
